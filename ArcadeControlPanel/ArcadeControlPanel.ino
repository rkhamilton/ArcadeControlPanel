/*
 Name:		ArcadeControlPanel.ino
 Created:	4/4/2016 8:53:32 PM
 Author:	Ryan Hamilton, ryan.hamilton@gmail.com

 Sketch for an bluetooth MAME control panel.
 Switches are managed by my custcom class HIDRawArcadeControlPanel.
 USB HID Raw codes are generated by HIDRawArcadeControlPanel.
 An adafruit Bluetooth EZ-Key module is used to send these HID codes to a Raspberry Pi 3 running RetroPie.

 Thanks to the following:
 Button library: https://github.com/t3db0t/Button
 Bluetooth hardware: https://www.adafruit.com/product/1535
 I'm using an Adafruit Feather 32u4, but any Arduino with hardware serial and enough GPIO would work: https://www.adafruit.com/product/2771
 
 */

// the setup function runs once when you press reset or power the board
#include <Arduino.h>
#include "HIDRawArcadeControlPanel.h"

// toggle printing debug data to USB serial
#define DEBUG_PRINT 0

HIDRawArcadeControlPanel cp = HIDRawArcadeControlPanel();

void setup() {
	if (DEBUG_PRINT)
	{
		Serial.begin(115200);
		delay(200);
	}
	// initialize connectiont to EZ-Key via Serial1. EZ Key talks at 9600 baud.
	Serial1.begin(9600);
}

void loop() {
	// check all switches in the control panel for updates
	// if any switches have changed, send them to the bluetooth module
	if (cp.wasChanged(true))
	{
		// print the HID codes to the USB serial port for debugging
		if (DEBUG_PRINT) 
		{
			for (size_t i = 0; i < HID_CODES_SIZE; i = i + 1) {
				Serial.print(cp.HIDCode[i], HEX);
			}
			Serial.print("\n");
			Serial.flush();
		}
		// send HIDCodes to the ADafruit EZ-Key Bluetooth module via Serial1. Based on:
		// https://learn.adafruit.com/introducing-bluefruit-ez-key-diy-bluetooth-hid-keyboard/sending-keys-via-serial
		Serial1.write(cp.HIDCode, HID_CODES_SIZE);
		Serial1.flush();
	}  
}

